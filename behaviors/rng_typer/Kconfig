## behaviors/rng_typer/Kconfig
```kconfig
# Copyright (c) 2024
# SPDX-License-Identifier: MIT

config ZMK_BEHAVIOR_RNG_TYPER
    bool "RNG Typer behavior (dice rolls, random ints, random strings)"
    depends on ENTROPY_GENERATOR
    help
      Enables a ZMK behavior that uses the nRF52 hardware RNG to type:
        - Dice rolls in dXX: N format
        - Full raw 32-bit random integers
        - Random 16-character strings with selectable charset

config ZMK_RNG_TYPER_WAIT_MS
    int "Delay in ms between key events when typing RNG output"
    depends on ZMK_BEHAVIOR_RNG_TYPER
    default 30
    help
      Time in milliseconds to sleep between each key press/release event.
      Matches ZMK's macro default (CONFIG_ZMK_MACRO_DEFAULT_WAIT_MS = 30).
      Increase to 50+ if characters are being dropped on lossy BLE connections.
      Decrease to 15 if you find the typing noticeably slow (e.g. 16-char strings).
```

## dts/bindings/behaviors/zmk,behavior-leader-key.yaml
```yaml
# Copyright (c) 2024
# SPDX-License-Identifier: MIT

description: |
  ZMK RNG Typer behavior.
  Uses the nRF52 hardware RNG (TRNG) to type random output.

  Binding parameters:
    param1 = mode
      0 = DICE   → types "dN: X"  (param2 = sides, e.g. 6 / 8 / 10 / 12 / 20 / 100)
      1 = INT    → types a raw integer in [0, param2)
      2 = STRING → types a 16-char random string (param2 = charset, see below)

    param2:
      DICE mode  → number of die sides (2–∞, default 6)
      INT  mode  → param2 ignored; types the full raw 32-bit RNG value (0–4294967295)
      STRING mode:
        0 = alphanumeric  a-z A-Z 0-9
        1 = hex           0-9 a-f
        2 = lowercase     a-z 0-9
        3 = symbols       alphanumeric + !@#$%^&*()-_=+[]{}

compatible: "zmk,behavior-rng-typer"

include: zero-param-behavior.yaml

properties:
  "#binding-cells":
    type: int
    const: 2
```

## dts/bindings/behaviors/zmk,behavior-rng-typer.yaml
```yaml
# Copyright (c) 2024
# SPDX-License-Identifier: MIT

description: |
  ZMK RNG Typer behavior.
  Uses the nRF52 hardware RNG (TRNG) to type random output.

  Binding parameters:
    param1 encodes mode + optional Enter flag:
      Bits [3:0] = mode
        0 = DICE   -> types "dN: X"  (param2 = sides, e.g. 6 / 8 / 10 / 12 / 20 / 100)
        1 = INT    -> types full raw 32-bit value (param2 ignored)
        2 = STRING -> types a 16-char random string (param2 = charset, see below)
      Bit 7 (0x80) = send Enter after output

    param2:
      DICE mode   -> number of die sides (2+, default 6)
      INT  mode   -> ignored; always full uint32
      STRING mode:
        0 = alphanumeric  a-z A-Z 0-9
        1 = hex           0-9 a-f
        2 = lowercase     a-z 0-9
        3 = symbols       alphanumeric + !@#$%^&*()-_=+[]{}

compatible: "zmk,behavior-rng-typer"

include: two_param.yaml
```
